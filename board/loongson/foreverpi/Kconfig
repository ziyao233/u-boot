## board/loongson/foreverpi/Kconfig
```kconfig
if TARGET_CTCISZ_FOREVER_PI

config SYS_BOARD
	default "ctcisz-foreverpi"

config SYS_VENDOR
	default "loongson"

config SYS_CPU
	default "generic"

config SYS_CONFIG_NAME
	default "ctcisz-foreverpi"

config DEFAULT_DEVICE_TREE
	default "loongson-2k0300-ctcisz-forever-pi"

config TEXT_BASE
	default 0x1000000

config BOARD_SPECIFIC_OPTIONS
	def_bool y
	select GENERIC_LOONGARCH
	imply SYS_NS16550

endif
```

## configs/ctcisz-foreverpi_defconfig
```kconfig
CONFIG_LOONGARCH=y
CONFIG_SYS_MALLOC_LEN=0x800000
CONFIG_SYS_MALLOC_F_LEN=0x4000
CONFIG_NR_DRAM_BANKS=8
CONFIG_ENV_SIZE=0x20000
CONFIG_DM_RESET=y
CONFIG_SYS_BOOTM_LEN=0x4000000
CONFIG_SYS_LOAD_ADDR=0x02000000
CONFIG_TARGET_CTCISZ_FOREVER_PI=y
# CONFIG_OF_BOARD_FIXUP is not set
CONFIG_FIT=y
CONFIG_BOOTSTD_FULL=y
CONFIG_USE_BOOTARGS=y
CONFIG_BOOTARGS_SUBST=y
CONFIG_DISPLAY_CPUINFO=y
CONFIG_DISPLAY_BOARDINFO=y
CONFIG_CMD_UFETCH=y
CONFIG_CMD_2048=y
CONFIG_PARTITION_TYPE_GUID=y
CONFIG_BLKMAP=y
CONFIG_EFI_MEDIA=y
CONFIG_DM_MTD=y
CONFIG_HEXDUMP=y
```
